## boards/shields/custom62/Kconfig.shield
```kconfig
# Copyright (c) 2020 Pete Johanson
# SPDX-License-Identifier: MIT

config SHIELD_CUSTOM62_LEFT
    def_bool $(shields_list_contains,custom62_left)

config SHIELD_CUSTOM62_RIGHT
    def_bool $(shields_list_contains,custom62_right)
```
